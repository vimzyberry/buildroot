## configs/esp32s3wifi_defconfig
```kconfig
BR2_xtensa=y
BR2_XTENSA_DYNCONFIG=y
BR2_TOOLCHAIN_EXTERNAL=y
BR2_TOOLCHAIN_EXTERNAL_PATH="/home/jcmvbkbc/ws/tensilica/crosstool/fdpic/builds/xtensa-esp32s3-linux-uclibcfdpic"
BR2_TOOLCHAIN_EXTERNAL_CUSTOM_PREFIX="$(ARCH)-esp32s3-linux-uclibcfdpic"
BR2_TOOLCHAIN_EXTERNAL_HEADERS_6_1=y
BR2_TOOLCHAIN_EXTERNAL_WCHAR=y
# BR2_TOOLCHAIN_EXTERNAL_HAS_THREADS_NPTL is not set
BR2_TARGET_LDFLAGS="-mfdpic"
BR2_ROOTFS_OVERLAY="board/espressif/esp32s3/rootfs_overlay"
BR2_ROOTFS_POST_BUILD_SCRIPT="board/espressif/esp32s3/trim-libnl.sh"
BR2_LINUX_KERNEL=y
BR2_LINUX_KERNEL_CUSTOM_GIT=y
BR2_LINUX_KERNEL_CUSTOM_REPO_URL="https://github.com/jcmvbkbc/linux-xtensa.git"
BR2_LINUX_KERNEL_CUSTOM_REPO_VERSION="xtensa-6.5-rc1-esp32wifi-nfs"
BR2_LINUX_KERNEL_DEFCONFIG="esp32s3wifi"
BR2_LINUX_KERNEL_IMAGE_TARGET_CUSTOM=y
BR2_LINUX_KERNEL_IMAGE_TARGET_NAME="xipImage"
BR2_LINUX_KERNEL_NEEDS_HOST_OPENSSL=y
BR2_PACKAGE_BUSYBOX_CONFIG="board/espressif/esp32s3/busybox.config"
BR2_PACKAGE_ZLIB=y
BR2_PACKAGE_DROPBEAR=y
BR2_PACKAGE_IW=y
BR2_PACKAGE_WIRELESS_REGDB=y
BR2_PACKAGE_WPA_SUPPLICANT=y
BR2_TARGET_ROOTFS_CRAMFS=y
BR2_TARGET_ROOTFS_CRAMFS_XIP=y
```
